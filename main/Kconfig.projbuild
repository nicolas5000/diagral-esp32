## main/Kconfig.projbuild
```kconfig
menu "Diagral UART Project Configuration"

    orsource "$IDF_PATH/examples/common_components/env_caps/$IDF_TARGET/Kconfig.env_caps"

    config CMD_LINE_MANAGEMENT_DEFAULT_PWD
        string "Command line password"
        default "diagral-esp32"
        help
            Up to 32 characters. Set to empty if you don't want to protect command line access by password (unsecure).

    choice CONNECTIVITY_CHOOSE_LAYER
        prompt "Choose between Wifi and Ethernet"
        default CONNECTIVITY_CHOICE_WIFI

        config CONNECTIVITY_CHOICE_WIFI
            bool "Wifi"
            depends on SOC_WIFI_SUPPORTED
        
        config CONNECTIVITY_CHOICE_ETH
            bool "Ethernet (W5500 SPI module)"
            select ETH_USE_SPI_ETHERNET
    endchoice

    choice IP_LAYER_CHOOSE_MODE
        prompt "Choose between DHCP and static IP"
        default CONNECTIVITY_CHOICE_DHCP

        config CONNECTIVITY_CHOICE_DHCP
            bool "DHCP"
        
        config CONNECTIVITY_CHOICE_STATIC
            bool "Static IP"
    endchoice

    config IP_LAYER_HOSTNAME
        string "Hostname"
        default "diagral-esp32"
        help
            Set hostname.

    config SNTP_TIME_SERVER
        string "SNTP server name"
        default "pool.ntp.org"
        help
            Hostname of the SNTP server.

    menu "Static IP Configuration"
        visible if CONNECTIVITY_CHOICE_STATIC

        config IP_LAYER_STATIC_IP_ADDR
        string "Static IP address"
        default "192.168.1.253"
        help
            Set static IP address.

        config IP_LAYER_STATIC_NETMASK_ADDR
            string "Static netmask address"
            default "255.255.255.0"
            help
                Set static netmask address.

        config IP_LAYER_STATIC_GW_ADDR
            string "Static gateway address"
            default "192.168.1.1"
            help
                Set static gateway address.

        config IP_LAYER_STATIC_DNS_SERVER_MAIN
            string "Main DNS server address"
            default "192.168.1.1"
            help
                Set main DNS server address.

        config IP_LAYER_STATIC_DNS_SERVER_BACKUP
            string "Backup DNS server address"
            default "192.168.1.1"
            help
                Set backup DNS server address. It can be same with the main DNS server address.
    endmenu

    menu "Wifi Configuration"
        depends on CONNECTIVITY_CHOICE_WIFI

        config ESP_WIFI_SSID
            string "WiFi SSID"
            default "myssid"
            help
                SSID (network name) to connect to.

        config ESP_WIFI_PASSWORD
            string "WiFi Password"
            default "mypassword"
            help
                WiFi password (WPA or WPA2) to use.

        choice ESP_WIFI_SAE_MODE
            prompt "WPA3 SAE mode selection"
            default ESP_STATION_WPA3_SAE_PWE_BOTH
            help
                Select mode for SAE as Hunt and Peck, H2E or both.
            config ESP_STATION_WPA3_SAE_PWE_HUNT_AND_PECK
                bool "HUNT AND PECK"
            config ESP_STATION_WPA3_SAE_PWE_HASH_TO_ELEMENT
                bool "H2E"
                depends on ESP_WIFI_ENABLE_SAE_H2E
            config ESP_STATION_WPA3_SAE_PWE_BOTH
                bool "BOTH"
                depends on ESP_WIFI_ENABLE_SAE_H2E
        endchoice

        config ESP_WIFI_PW_ID
            string "Password identifier for SAE H2E"
            depends on  ESP_STATION_WPA3_SAE_PWE_HASH_TO_ELEMENT || ESP_STATION_WPA3_SAE_PWE_BOTH
            default ""

        choice ESP_WIFI_SCAN_AUTH_MODE_THRESHOLD
            prompt "WiFi Scan auth mode threshold"
            default ESP_WIFI_AUTH_WPA2_WPA3_PSK
            help
                The weakest authmode to accept in the scan mode.
                This value defaults to ESP_WIFI_AUTH_WPA2_PSK in case password is present and ESP_WIFI_AUTH_OPEN is used.
                Please select ESP_WIFI_AUTH_WEP/ESP_WIFI_AUTH_WPA_PSK in case AP is operating in WEP/WPA mode.

            config ESP_WIFI_AUTH_OPEN
                bool "OPEN (unsecure)"
            config ESP_WIFI_AUTH_WEP
                bool "WEP (unsecure)"
            config ESP_WIFI_AUTH_WPA_PSK
                bool "WPA PSK (unsecure)"
            config ESP_WIFI_AUTH_WPA_WPA2_PSK
                bool "WPA/WPA2 PSK (unsecure)"
            config ESP_WIFI_AUTH_WPA2_PSK
                bool "WPA2 PSK"
            config ESP_WIFI_AUTH_WAPI_PSK
                bool "WAPI PSK"
            config ESP_WIFI_AUTH_WPA2_WPA3_PSK
                bool "WPA2/WPA3 PSK"
            config ESP_WIFI_AUTH_WPA3_PSK
                bool "WPA3 PSK"
        endchoice
    endmenu

    menu "Ethernet Configuration"
        depends on CONNECTIVITY_CHOICE_ETH

        choice ETHERNET_SPI_HOST
            prompt "Choose SPI_HOST to use for Ethernet module"
            default ETHERNET_SPI_HOST2
            help
                You can use same SPI_HOST for Ethernet and radio modules and share SCLK, MOSI and MISO pins.

            config ETHERNET_SPI_HOST2
                bool "SPI_HOST2"
            
            config ETHERNET_SPI_HOST3
                bool "SPI_HOST3"
                depends on SOC_SPI_PERIPH_NUM > 2
        endchoice

        config ETHERNET_SPI_CLOCK_MHZ
            int "SPI clock speed (MHz) for Ethernet module"
            range 5 80
            default 40
            help
                Set the clock speed (MHz) of SPI interface. Note: some modules crash at speed greater than 60, increase carefully!

        config ETHERNET_SPI_CS_GPIO
            int "SPI CS GPIO number for SPI Ethernet module"
            range ENV_GPIO_RANGE_MIN ENV_GPIO_IN_RANGE_MAX
            default 5
            help
                Set the GPIO number used by SPI CS, i.e. Chip Select associated with the SPI Eth module).

        config ETHERNET_SPI_INT0_GPIO
            int "Interrupt GPIO number SPI Ethernet module"
            range ENV_GPIO_RANGE_MIN ENV_GPIO_IN_RANGE_MAX
            default 6
            help
                Set the GPIO number used by the SPI Ethernet module interrupt line.

        config ETHERNET_SPI_PHY_RST_GPIO
            int "PHY Reset GPIO number of SPI Ethernet Module"
            range ENV_GPIO_RANGE_MIN ENV_GPIO_OUT_RANGE_MAX
            default 1
            help
                Set the GPIO number used to reset PHY chip on the SPI Ethernet module.
    endmenu

    menu "Diagral Configuration"

        config DIAGRAL_UART_LOGGING_ENABLED
            bool "Enable logging in Diagral UART layer"
            default y

        config DIAGRAL_UART_PASSIVE_MODE
            bool "Passive only (not allowed to emit)"
            default n

        config DIAGRAL_MQTT_COMMAND_CHECK_PIN
            bool "Check PIN code when receiving command from MQTT"
            default y
            help
                When receiving a command from MQTT, decide if valid PIN code will have to be included.

        config DIAGRAL_UART_PORT_NUM
            int "UART port to use to connect to Diagral"
            range 0 SOC_UART_HP_NUM
            default 0
            help
                See UART documentation for available port numbers.

        config DIAGRAL_UART_TXD
            int "UART TXD GPIO Num"
            range ENV_GPIO_RANGE_MIN ENV_GPIO_OUT_RANGE_MAX
            default 43
            help
                GPIO number for pin connected to Diagral RX (Pin 8 on Diagral board 20 pins connector).

        config DIAGRAL_UART_RXD
            int "UART RXD GPIO Num"
            range ENV_GPIO_RANGE_MIN ENV_GPIO_OUT_RANGE_MAX
            default 44
            help
                GPIO number for pin connected to Diagral TX (Pin 10 on Diagral board 20 pins connector).

        config DIAGRAL_TX_SIGNAL
            int "TX Signal GPIO Num"
            range ENV_GPIO_RANGE_MIN ENV_GPIO_OUT_RANGE_MAX
            default 7
            help
                GPIO number for pin connected to Diagral TX Signal (Pin 9 on Diagral board 20 pins connector).
    endmenu

    menu "MQTT Client configuration"
        config MQTT_CLIENT_ENABLE
            bool "Enable MQTT client"
            default y

        config MQTT_BROKER_ADDRESS
            string "MQTT Broker address"
            default "192.168.1.203"
            help
                MQTT broker address.
        
        config MQTT_BROKER_PORT
            int "MQTT Broker port"
            range 1 65535
            default 1883
            help
                MQTT broker listening port.

        config MQTT_CLIENT_USERNAME
            string "MQTT Client username"
            default "mqtt_user"
            help
                MQTT Client username to connect to broker.

        config MQTT_CLIENT_PASSWORD
            string "MQTT Client password"
            default "mqtt_password"
            help
                MQTT Client password to connect to broker.

        config MQTT_CLIENT_TLS_ENABLED
            bool "Enable TLS to connect to broker"
            default n

        config MQTT_BROKER_CERTIFICATE
            string "MQTT broker certificate"
            default "-"
            help
                MQTT broker certificate (content of .pem file without --- BEGIN CERTIFICATE --- and ---END CERTIFICATE ---).

        config MQTT_DISCOVERY_ID_NAME
            string "MQTT Discovery ID and name"
            default "diagral-esp32"
            help
                ID and Name to set in Discovery message to identify the device in HomeAssistant
        
        config MQTT_TOPIC_PREFIX
            string "MQTT topic prefix"
            default "diagral-esp32"
            help
                Prefix added before all MQTT topics except discovery.
        
        config MQTT_DISCOVERY_PREFIX
            string "MQTT discovery prefix"
            default "homeassistant/device/diagral-esp32"
            help
                Prefix added before discovery topic. Discovery topic will be <MQTT_DISCOVERY_PREFIX>/config
    endmenu

    menu "Syslog Configuration"
        config SYSLOG_ENABLED
            bool "Enable remote syslog"
            default n
            help
                Forward ESP log output to a remote UDP syslog server (RFC 3164).
                Settings can also be changed at runtime via config_syslog command.

        config SYSLOG_SERVER
            string "Syslog server hostname or IP"
            default "192.168.1.250"
            depends on SYSLOG_ENABLED
            help
                Hostname or IP address of the syslog server (e.g. 192.168.1.10).

        config SYSLOG_PORT
            int "Syslog UDP port"
            range 1 65535
            default 514
            depends on SYSLOG_ENABLED
            help
                UDP port of the syslog server. Standard port is 514.

        config SYSLOG_FACILITY
            int "Syslog facility number (0-23)"
            range 0 23
            default 1
            depends on SYSLOG_ENABLED
            help
                RFC 3164 facility: 0=kern 1=user 2=mail 3=daemon 16-23=local0-7.

        config SYSLOG_MIN_LEVEL
            int "Minimum severity to forward (0-7)"
            range 0 7
            default 7
            depends on SYSLOG_ENABLED
            help
                RFC 5424 severity threshold: 3=error 4=warning 6=info 7=debug.
                Messages with severity higher than this value are dropped.

    endmenu

    menu "Battery Configuration"

        config DIAGRAL_BATTERY_ENABLED
            bool "Enable battery voltage monitoring"
            default y

        config DIAGRAL_BATTERY_ADC_UNIT
            depends on DIAGRAL_BATTERY_ENABLED
            int "ADC Unit"
            range 1 2
            default 1

        config DIAGRAL_BATTERY_ADC_CHANNEL
            depends on DIAGRAL_BATTERY_ENABLED
            int "ADC channel"
            range 0 9
            default 7

        config DIAGRAL_BATTERY_VOLTAGE_MIN
            depends on DIAGRAL_BATTERY_ENABLED
            int "Minimum battery voltage (mV) corresponding to 0%"
            range 0 3300
            default 1500

        config DIAGRAL_BATTERY_VOLTAGE_MAX
            depends on DIAGRAL_BATTERY_ENABLED
            int "Maximum battery voltage (mV) corresponding to 100%"
            range 0 3300
            default 2050
    endmenu

    menu "SPI_HOST2 Configuration"
        depends on ETHERNET_SPI_HOST2 || IOHOMECONTROL_SX1276_SPI_HOST2

        config SPI_HOST2_SCK
            int "SPI SCK GPIO Num"
            range ENV_GPIO_RANGE_MIN ENV_GPIO_OUT_RANGE_MAX
            default 4
            help
                GPIO number for SPI SCK pin connected to SPI_HOST2.

        config SPI_HOST2_MOSI
            int "SPI MOSI GPIO Num"
            range ENV_GPIO_RANGE_MIN ENV_GPIO_OUT_RANGE_MAX
            default 3
            help
                GPIO number for SPI MOSI pin connected to SPI_HOST2.

        config SPI_HOST2_MISO
            int "SPI MISO GPIO Num"
            range ENV_GPIO_RANGE_MIN ENV_GPIO_OUT_RANGE_MAX
            default 2
            help
                GPIO number for SPI MISO pin connected to SPI_HOST2.

    endmenu

    menu "SPI_HOST3 Configuration"
        depends on ETHERNET_SPI_HOST3 || IOHOMECONTROL_SX1276_SPI_HOST3
        
        config SPI_HOST3_SCK
            int "SPI SCK GPIO Num"
            range ENV_GPIO_RANGE_MIN ENV_GPIO_OUT_RANGE_MAX
            default 11
            help
                GPIO number for SPI SCK pin connected to SPI_HOST3.

        config SPI_HOST3_MOSI
            int "SPI MOSI GPIO Num"
            range ENV_GPIO_RANGE_MIN ENV_GPIO_OUT_RANGE_MAX
            default 12
            help
                GPIO number for SPI MOSI pin connected to SPI_HOST3.

        config SPI_HOST3_MISO
            int "SPI MISO GPIO Num"
            range ENV_GPIO_RANGE_MIN ENV_GPIO_OUT_RANGE_MAX
            default 13
            help
                GPIO number for SPI MISO pin connected to SPI_HOST3.

    endmenu

endmenu
```
